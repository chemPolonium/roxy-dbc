VERSION ""

NS_ :

BS_:

BU_:

BO_ 1 NewMessage_0001: 8 Vector__XXX
 SG_ NewSignal_0003 : 0|8@1+ (1,0) [0|0] "" Vector__XXX

BO_ 2 NewMessage_0002: 8 Vector__XXX
 SG_ NewSignal_0002 : 0|8@1+ (1,0) [0|0] "" Vector__XXX

BO_ 3 NewMessage_0003: 8 Vector__XXX
 SG_ NewSignal_0001 : 0|8@1+ (1,0) [0|0] "" Vector__XXX

CM_ BO_ 1 "测试消息1";
CM_ SG_ 1 NewSignal_0003 "测试信号1";
CM_ BO_ 2 "测试消息2";
CM_ BO_ 3 "测试消息3";
