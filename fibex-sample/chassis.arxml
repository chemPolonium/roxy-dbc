AUTOSAR XML (schema 4.0)
package /FlexRayDb
  flexray cluster PowertrainCluster:  # roxy-fibex FlexRay sample (AUTOSAR R4.0 style)
    flexray-coldstart-attempts=8
    flexray-cycle=1000
    flexray-g-number-of-minislots=292
    flexray-g-number-of-static-slots=10
    flexray-gd-action-point-offset=3
    flexray-gd-dynamic-slot-idle-phase=1
    flexray-gd-macrotick-duration=5.0
    flexray-gd-minislot=9
    flexray-gd-minislot-action-point-offset=2
    flexray-gd-minor-version=3
    flexray-gd-nit=75
    flexray-gd-static-slot=67
    flexray-gd-symbol-window=1
    flexray-gd-symbol-window-idle-phase=1
    flexray-offset-correction-start=233
    flexray physical channel ChannelA
      frame EngineData: frame-length=8, payload-preamble=false, slot-id=1, cycle-repetition=CYCLE-REPETITION-1, base-cycle=0, startup-frame=true  # Engine status, transmitted every cycle
      frame TransmissionData: frame-length=8, payload-preamble=false, slot-id=2, cycle-repetition=CYCLE-REPETITION-1, base-cycle=0, startup-frame=true
      frame DashInfo: frame-length=8, payload-preamble=false, slot-id=4, cycle-repetition=CYCLE-REPETITION-8, base-cycle=0, startup-frame=false  # Multi-PDU frame: reuses Eng_PDU at offset 0
    flexray physical channel ChannelB
      frame EngineData: frame-length=8, payload-preamble=false, slot-id=1, cycle-repetition=CYCLE-REPETITION-1, base-cycle=0, startup-frame=true  # Engine status, transmitted every cycle
      frame ChassisStatus: frame-length=12, payload-preamble=false, slot-id=3, cycle-repetition=CYCLE-REPETITION-4, base-cycle=0, startup-frame=false
      frame DashInfo: frame-length=8, payload-preamble=false, slot-id=4, cycle-repetition=CYCLE-REPETITION-8, base-cycle=0, startup-frame=false  # Multi-PDU frame: reuses Eng_PDU at offset 0
  4 x ecu instance:
    EngECU
    TransECU
    ChassisECU
    DashECU
  pdu Eng_PDU: length=4
    signal EngineSpeed: start 0, 16 bit, big-endian, length=16  # Engine speed measured at crankshaft
    signal CoolantTemp: start 16, 8 bit, big-endian, length=8
    signal ThrottlePos: start 24, 8 bit, big-endian, length=8
  pdu Trans_PDU: length=4
    signal GearEngaged: start 0, 8 bit, big-endian, length=8
    signal TransTemp: start 8, 8 bit, big-endian, length=8
    signal TorqueReq: start 16, 16 bit, big-endian, length=16
  pdu Chassis_PDU: length=8
    signal WheelSpeedFL: start 0, 16 bit, big-endian, length=16
    signal WheelSpeedFR: start 16, 16 bit, big-endian, length=16
    signal YawRate: start 32, 16 bit, big-endian, length=16
    signal ChassisStatus: start 48, big-endian, frame-length=12, payload-preamble=false, length=8
  pdu Dash_PDU: length=4
    signal Odometer: start 0, 24 bit, big-endian, length=24
    signal FuelLevel: start 24, 8 bit, big-endian, length=8
  i signal ChassisStatus: length=8
